## conf/machine/da830-omapl137-evm.conf
```bitbake
#@TYPE: Machine
#@NAME: DA830 CPUs on a DA830 EVM board
#@DESCRIPTION: Machine configuration for the TI DA830 EVM board

require conf/machine/include/davinci.inc
require conf/machine/include/omapl137.inc

UBOOT_MACHINE = "da830evm_config"
UBOOT_ENTRYPOINT = "0xc0008000"
UBOOT_LOADADDRESS = "0xc0008000"

IMAGE_FSTYPES += "tar.gz ubi"

MACHINE_FEATURES = "kernel26 serial ethernet"

SERIAL_CONSOLE = "115200 ttyS2"

PREFERRED_PROVIDER_virtual/kernel = "linux-omapl137-psp"
PREFERRED_PROVIDER_virtual/bootloader = "u-boot"
```
